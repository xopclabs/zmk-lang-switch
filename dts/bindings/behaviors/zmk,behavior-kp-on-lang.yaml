## dts/bindings/behaviors/zmk,behavior-kp-on-lang.yaml
```yaml
# Copyright (c) 2024 The ZMK Contributors
# SPDX-License-Identifier: MIT

description: Press key on specific language

compatible: "zmk,behavior-kp-on-lang"

include: one_param.yaml

properties:
  bindings:
    type: phandle-array
    required: true
```

## dts/bindings/behaviors/zmk,behavior-lang-switch.yaml
```yaml
# Copyright (c) 2024 The ZMK Contributors
# SPDX-License-Identifier: MIT

description: Language switch behavior

compatible: "zmk,behavior-lang-switch"

include: one_param.yaml

properties:
  bindings:
    type: phandle-array
    required: true
  layers:
    type: array
    required: true
  no-layer-switch:
    type: boolean
```

## dts/bindings/behaviors/zmk,behavior-sticky-key-layer.yaml
```yaml
# Copyright (c) 2025 The ZMK Contributors
# SPDX-License-Identifier: MIT

description: Sticky key behavior with temporary layer switch

compatible: "zmk,behavior-sticky-key-layer"

include: one_param.yaml

properties:
  bindings:
    type: phandles
    required: true
  target-layer:
    type: int
    required: true
  release-after-ms:
    type: int
    required: true
  quick-release:
    type: boolean
  lazy:
    type: boolean
  ignore-modifiers:
    type: boolean 
```
